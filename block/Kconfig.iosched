## drivers/video/display/Kconfig
```kconfig
#
# Display drivers configuration
#

menu "Display device support"

config DISPLAY_SUPPORT
	tristate "Display panel/monitor support"
	depends on FB_RK29 || FB_ROCKCHIP
	---help---
	  This framework adds support for low-level control of a display.
	  This includes support for power.

	  Enable this to be able to choose the drivers for controlling the
	  physical display panel/monitor on some platforms. This not only
	  covers LCD displays for PDAs but also other types of displays
	  such as CRT, TVout etc.

	  To have support for your specific display panel you will have to
	  select the proper drivers which depend on this option.

comment "Display hardware drivers"
	depends on DISPLAY_SUPPORT
if ARCH_RK29
source "drivers/video/display/screen/Kconfig"
endif
choice
	depends on TOUCHSCREEN_GT8XX && DISPLAY_SUPPORT
	prompt "Screen Size Resolution"
	default SCREEN_BONOVO_1024X600
	config SCREEN_BONOVO_1024X600
		bool "1024 X 600"
		help
			the size of screen is 1024*600 
	config SCREEN_BONOVO_800X480
		bool "800 X 480"
		help
			the size of screen is 800*480 
	config SCREEN_BONOVO_800X600
		bool "800 X 600"
		help
			the size of screen is 800*600 
endchoice
endmenu
```
